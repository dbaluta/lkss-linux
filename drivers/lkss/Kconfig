## drivers/lkss/Kconfig
```kconfig
# SPDX-License-Identifier: GPL-2.0-only

menuconfig LKSS_DRIVERS
	bool "Linux Kernel Summer School drivers"
	default n
	help
	  Enable support for Linux Kernel Summer School drivers.

if LKSS_DRIVERS

config LKSS_DRIVERS_LAB1
	bool "Linux Kernel Summer School lab 1 drivers"
	default n
	help
	  Enable support for lab 1 drivers.


config LKSS_DRIVERS_LAB2
	bool "Linux Kernel Summer School lab 2 drivers"
	default n
	help
	  Enable support for lab 2 drivers.

source "drivers/lkss/lab2/Kconfig"

endif # LKSS_DRIVERS
```

## drivers/lkss/lab2/Kconfig
```kconfig
# SPDX-License-Identifier: GPL-2.0-only

if LKSS_DRIVERS_LAB2

config LKSS_DRIVERS_LAB2_EX1
	tristate "Lab2 Ex1 - Simple character device driver"
	help
	  Compile Lab2 Ex1: Simple character device driver

config LKSS_DRIVERS_LAB2_EX2
	tristate "Lab2 Ex2 - Command a timer using a character device"
	help
	  Compile Lab2 Ex2: Command a timer using a character device

config LKSS_DRIVERS_LAB2_EX3
	tristate "Lab2 Ex3 - Character device LED driver using gpiod"
	help
	  Compile Lab2 Ex3: Character device LED driver using gpiod

config LKSS_DRIVERS_LAB2_EX3_IOCTL
        bool "Enable ioctl call for ex3 driver"
        depends on LKSS_DRIVERS_LAB2_EX3
        help
          Compile with support for ioctl() call

config LKSS_DRIVERS_LAB2_EX4
	tristate "Lab2 Ex4 - Using buttons with irqs for LED ctrl"
	help
	  Compile Lab2 Ex4: Using buttons with irqs for LED ctrl

endif # LKSS_DRIVERS_LAB2
```

## drivers/lkss/lab3/Kconfig
```kconfig
# SPDX-License-Identifier: GPL-2.0-only

if LKSS_DRIVERS_LAB3

config LKSS_DRIVERS_LAB3_ST7789
	tristate "Lab3 ST7789 simple driver"
	help
	  Compile Lab3 st7789 simple driver

config LKSS_DRIVERS_LAB3_GPIO
	tristate "Lab3 Platform GPIO driver for buttons and LEDs (exercise 12)"
	help
	  Compile the Lab3 platform GPIO driver. Handles 4 push-buttons
	  and 3 LEDs from the LKSS daughter board and exposes them via
	  sysfs attributes on the platform device.

endif # LKSS_DRIVERS_LAB3
```

## drivers/lkss/labs/lab1/Kconfig
```kconfig
menuconfig LKSS_LAB1
	tristate "LKSS Lab 1 drivers"
	help
	  Enables the skeleton drivers used in Lab 1 of the Linux Kernel
	  Summer School. Select M to build them as loadable modules (recommended
	  during development) or Y to compile them directly into the kernel Image.

if LKSS_LAB1

config LKSS_LAB1_HELLO
	tristate "Exercise 1: Hello World module"
	help
	  A minimal kernel module that prints a message on load and unload.
	  Used in Exercise 1 to study module anatomy, insmod/rmmod, and dmesg.

config LKSS_LAB1_OOPS
	tristate "Exercise 4: Kernel Oops demonstration"
	help
	  A module that deliberately dereferences a NULL pointer to trigger
	  a kernel oops. Used in Exercise 4 to study kernel fault handling
	  and oops/panic output.

config LKSS_LAB1_TIMER
	tristate "Exercise 5: Kernel Timer demonstration"
	help
	  A module that arms a one-shot kernel timer. Students extend it to
	  fire periodically and observe a crash inside a timer callback.

endif # LKSS_LAB1
```

## drivers/lkss/labs/lab3_final/Kconfig
```kconfig
# SPDX-License-Identifier: GPL-2.0

config LKSS_LAB3_ST7789_SKELETON
	tristate "Lab 3: ST7789 SPI driver skeleton (student TODO version)"
	depends on SPI && GPIOLIB
	help
	  Skeleton SPI driver for LKSS Lab 3. All key functions have
	  TODO markers that students must fill in, exercise by exercise.

	  Do NOT load this module at the same time as LKSS_LAB3_ST7789
	  (both use the same DT compatible string).

	  To compile as a module, choose M. The module will be called
	  lkss_st7789_skeleton.

config LKSS_LAB3_ST7789
	tristate "Lab 3: ST7789 SPI driver full solution"
	depends on SPI && GPIOLIB
	help
	  Complete SPI display driver for LKSS Lab 3. Implements all
	  primitives: hw_reset, init, fill, fill_rect, draw_pixel,
	  draw_line, draw_circle, fill_circle, and a demo pattern.

	  Do NOT load this module at the same time as
	  LKSS_LAB3_ST7789_SKELETON.

	  To compile as a module, choose M. The module will be called
	  lkss_st7789.
```

## drivers/lkss/labs/lab4/Kconfig
```kconfig
menuconfig LKSS_LAB4
	tristate "LKSS Lab 4 drivers"
	help
	  Enables the drivers used in Lab 4 of the Linux Kernel Summer School.
	  Select M to build them as loadable modules (recommended during
	  development) or Y to compile them directly into the kernel Image.

if LKSS_LAB4

config LKSS_LAB4_GPIO
	tristate "GPIO platform driver: LED blinking + button interrupts"
	depends on GPIOLIB && OF
	help
	  Platform driver that binds to the "lkss,lab4" Device Tree node.

	  It registers three LED GPIOs (red, green, blue) with sysfs-controlled
	  blinking via kernel timers, and four button GPIOs with edge-triggered
	  threaded interrupt handlers that print a message on press and release.

	  Sysfs files (under /sys/bus/platform/devices/lkss-lab4/):
	    led0, led1, led2 — write 1 to blink, 0 to stop

	  Hardware (FRDM-IMX93 EXT2 header):
	    LED0 red   GPIO2_IO07 pin 26
	    LED1 green GPIO2_IO04 pin  7
	    LED2 blue  GPIO2_IO18 pin 12
	    BTN1       GPIO2_IO05 pin 29
	    BTN2       GPIO2_IO06 pin 31
	    BTN3       GPIO2_IO00 pin 27
	    BTN4       GPIO2_IO01 pin 28

endif # LKSS_LAB4
```
